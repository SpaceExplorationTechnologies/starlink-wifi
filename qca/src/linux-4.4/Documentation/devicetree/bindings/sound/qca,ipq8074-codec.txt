## qca/src/linux-4.4/Documentation/devicetree/bindings/sound/qca,ipq8074-codec.txt
```
* Qualcomm Technologies, Inc IPQ8074 ASoC Codec driver

This node models the Qualcomm Technologies, Inc IPQ8074 ASoC Codec driver

Required properties:

- compatible	: "qca,ipq8074-codec"
- reg		: should have the stereo i2c register address

Example:
qca_codec: qca_codec@12 {
	compatible = "qca,ipq8074-codec";
	reg = <0x12>;
	status = "disabled";
};
```

## qca/src/linux-4.4/Documentation/devicetree/bindings/sound/qca,ipq8074-pcm-lb.txt
```
qca,ipq8074-pcm-lb

VOIP PCM driver loopback test module for IPQ8074

Required properties:

  - compatible : "qca,ipq8074-pcm-lb"

Example:

pcm_lb: pcm_lb@0 {
        compatible = "qca,ipq8074-pcm-lb";
};
```

## qca/src/linux-4.4/Documentation/devicetree/bindings/sound/qca,ipq8074-pcm-tdm.txt
```
* Qualcomm Technologies, Inc IPQ8074 ASoC TDM platform driver

This node models the Qualcomm Technologies, Inc IPQ8074 ASoC TDM platform driver

Required properties:

- compatible	 : "qca,ipq8074-pcm-tdm"
- reg		 : should have the stereo register address, length

Example:
tdmplatform: qca-pcm-tdm@7709000 {
	compatible = "qca,ipq8074-pcm-tdm";
	reg = <0x7709000 0x1000>;
	status = "disabled";
};
```

## qca/src/linux-4.4/Documentation/devicetree/bindings/sound/qca,ipq8074-pcm.txt
```
qca,ipq8074-pcm

VOIP PCM driver for IPQ8074

Required properties:

  - compatible     : "qca,ipq8074-pcm"
  - reg		   : should have the pcm register address, length
  - dma-tx-channel : should have the mbox tx channel id
  - dma-rx-channel : should have the mbox rx channel id
  - stereo-tx-port : should have the stereo tx id
  - stereo-rx-port : should have the stereo rx id


Example:

pcm: pcm_@7704000 {
        compatible = "qca,ipq8074-pcm";
	reg = <0x7704000 0x2000>;
	dma-tx-channel = <MBOX3_TX_ID>;
	dma-rx-channel = <MBOX0_RX_ID>;
	stereo-tx-port = <STEREO3_ID>;
	stereo-rx-port = <STEREO0_ID>;
	status = "disabled";
};
```

## qca/src/linux-4.4/Documentation/devicetree/bindings/sound/qca,ipq8074-stereo.txt
```
* Qualcomm Technologies, Inc IPQ8074 ASoC stereo driver

This node models the Qualcomm Technologies, Inc IPQ8074 ASoC stereo driver

Required properties:

- compatible	 : "qca,ipq8074-stereo"
- reg		 : should have the stereo register address, length
- stereo-index	 : should have the stereo port index

Example:
stereo0: stereo@7709000 {
	compatible = "qca,ipq8074-stereo";
	reg = <0x7709000 0x1000>;
	stereo-index = <STEREO0_ID>;
	status = "disabled";
};
```

## qca/src/linux-4.4/Documentation/devicetree/bindings/sound/qcom,adcc-ipq4019.txt
```
* Qualcomm Technologies IPQ4019 ASoC audio clock driver

This node models the Qualcomm Technologies IPQ4019 ASoC audio clock driver

Required properties:

- compatible	 : "qcom,adcc-ipq4019"
- reg		 : should have the stereo register address, length

Example:
adcc: clock-controller@7700038 {
	compatible = "qcom,adcc-ipq4019";
	#clock-cells = <1>;
	#reset-cells = <1>;
	reg = <0x7700038 0x1DC>;
	status = "disabled";
};
```

## qca/src/linux-4.4/Documentation/devicetree/bindings/usb/qca,ath79-ehci.txt
```
ATH79 USB EHCI controllers

Required properties:
  - compatible : should be "qca, ath79-ehci".
  - reg : should contain at least address and length of the standard EHCI
    register set for the device. Optional platform-dependent registers
    (debug-port or other) can be also specified here, but only after
    definition of standard EHCI registers.
  - interrupts : one EHCI interrupt should be described here.

Optional properties:
 - big-endian-regs : boolean, set this for hcds with big-endian registers
 - big-endian-desc : boolean, set this for hcds with big-endian descriptors
 - big-endian : boolean, for hcds with big-endian-regs + big-endian-desc
 - needs-reset-on-resume : boolean, set this to force EHCI reset after resume
 - has-transaction-translator : boolean, set this if EHCI have a Transaction
				Translator built into the root hub.
 - clocks : a list of phandle + clock specifier pairs
 - phys : phandle + phy specifier pair
 - phy-names : "usb"
 - resets : phandle + reset specifier pair
 - qca_force_host_mode: Set, if host mode to be forced for ATH79 SoCs
 - qca_force_16bit_ptw: Set, if 16bit ptw to be forced for ATH79 SoCs
 - caps-offset: Specify the caps offset

Example (Qualcomm Atheros ATH79 SoC)

   ehci0: usb@1b000000 {
	   compatible = "qca,ath79-ehci", "qca,ap135-ehci", qca,ap137-ehci", "qca,ap147-ehci";
	   reg = <0x1b000000 0x200>;
	   interrupt-parent = <&ip3_int>;
	   interrupts = <0>;
	   has-transaction-translator;
	   qca_force_host_mode;
	   qca_force_16bit_ptw;
	   caps-offset = <0x100>;
	   status = "okay";
   };
```

## qca/src/linux-4.4/Documentation/devicetree/bindings/usb/usb-ehci.txt
```
USB EHCI controllers

Required properties:
  - compatible : should be "generic-ehci".
  - reg : should contain at least address and length of the standard EHCI
    register set for the device. Optional platform-dependent registers
    (debug-port or other) can be also specified here, but only after
    definition of standard EHCI registers.
  - interrupts : one EHCI interrupt should be described here.

Optional properties:
 - big-endian-regs : boolean, set this for hcds with big-endian registers
 - big-endian-desc : boolean, set this for hcds with big-endian descriptors
 - big-endian : boolean, for hcds with big-endian-regs + big-endian-desc
 - needs-reset-on-resume : boolean, set this to force EHCI reset after resume
 - has-transaction-translator : boolean, set this if EHCI have a Transaction
				Translator built into the root hub.
 - clocks : a list of phandle + clock specifier pairs
 - phys : phandle + phy specifier pair
 - phy-names : "usb"
 - resets : phandle + reset specifier pair
 - qca_force_host_mode: Set, if host mode to be forced for ATH79 SoCs
 - qca_force_16bit_ptw: Set, if 16bit ptw to be forced for ATH79 SoCs
 - caps-offset: Specify the caps offset


Example (Sequoia 440EPx):
    ehci@e0000300 {
	   compatible = "ibm,usb-ehci-440epx", "usb-ehci";
	   interrupt-parent = <&UIC0>;
	   interrupts = <1a 4>;
	   reg = <0 e0000300 90 0 e0000390 70>;
	   big-endian;
   };

Example (Allwinner sun4i A10 SoC):
   ehci0: usb@01c14000 {
	   compatible = "allwinner,sun4i-a10-ehci", "generic-ehci";
	   reg = <0x01c14000 0x100>;
	   interrupts = <39>;
	   clocks = <&ahb_gates 1>;
	   phys = <&usbphy 1>;
	   phy-names = "usb";
   };

Example (Qualcomm Atheros ATH79 SoC)

   ehci0: usb@1b000000 {
	   compatible = "qca,ath79-ehci", "qca,ap135-ehci", qca,ap137-ehci", "qca,ap147-ehci";
	   reg = <0x1b000000 0x200>;
	   interrupt-parent = <&ip3_int>;
	   interrupts = <0>;
	   has-transaction-translator;
	   qca_force_host_mode;
	   qca_force_16bit_ptw;
	   caps-offset = <0x100>;
	   status = "okay";
   };
```

## qca/src/linux-4.4/Documentation/devicetree/bindings/watchdog/qcom-wdt.txt
```
Qualcomm Krait Processor Sub-system (KPSS) Watchdog
---------------------------------------------------

Required properties :
- compatible : shall contain only one of the following:

			"qcom,kpss-wdt-msm8960"
			"qcom,kpss-wdt-apq8064"
			"qcom,kpss-wdt-ipq8064"
			"qcom,kpss-wdt-ipq807x"
			"qcom,kpss-wdt-ipq40xx"

- reg : shall contain base register location and length as listed
	in the reg-names property
- reg-names: Include the following entries
	- "kpss_wdt" Qualcomm watchdog registers (Required)
	- "tlv" Memory mapped location for saving crashdump data in
		TLV format (Optional)


- clocks : shall contain the input clock

Optional properties :
- timeout-sec : shall contain the default watchdog timeout in seconds,
                if unset, the default timeout is 30 seconds
- interrupts : shall contain the interrupt number

Example:
	watchdog@208a038 {
		compatible = "qcom,kpss-wdt-ipq8064", "qcom,kpss-wdt-ipq807x", "qcom,kpss-wdt-ipq40xx";
		reg = <0x0208a038 0x40>, <0x87b70000 0x10000>;
		reg-names = "kpss_wdt", "tlv";
		clocks = <&sleep_clk>;
		timeout-sec = <10>;
		interrupts = <0 3 0>;
	};
```

## qca/src/linux-4.4/arch/arm/mach-qcom/Kconfig
```kconfig
menuconfig ARCH_QCOM
	bool "Qualcomm Support" if ARCH_MULTI_V7
	select ARCH_SUPPORTS_BIG_ENDIAN
	select ARM_GIC
	select ARM_AMBA
	select PINCTRL
	select QCOM_SCM if SMP
	select PCI_DOMAINS if PCI
	help
	  Support for Qualcomm's devicetree based systems.

if ARCH_QCOM

config ARCH_MSM8X60
	bool "Enable support for MSM8X60"
	select CLKSRC_QCOM

config ARCH_MSM8960
	bool "Enable support for MSM8960"
	select CLKSRC_QCOM

config ARCH_MSM8974
	bool "Enable support for MSM8974"
	select HAVE_ARM_ARCH_TIMER

config ARCH_IPQ807x
	bool "Enable Support for IPQ807x"
	select PINCTRL_IPQ807x
	select COMMON_CLK_QCOM
	select IPQ_APSS_807x
	select IPQ_GCC_807x
	help
	  This enables support for the IPQ807x chipset. If you dont
	  know what do here, say N
endif
```

## qca/src/linux-4.4/arch/mips/ath79/Kconfig
```kconfig
if ATH79

menu "Atheros AR71XX/AR724X/AR913X machine selection"

config ATH79_MACH_AP121
	bool "Atheros AP121 reference board"
	select SOC_AR933X
	select ATH79_DEV_ETH
	select ATH79_DEV_GPIO_BUTTONS
	select ATH79_DEV_LEDS_GPIO
	select ATH79_DEV_M25P80
	select ATH79_DEV_USB
	select ATH79_DEV_WMAC
	help
	  Say 'Y' here if you want your kernel to support the
	  Atheros AP121 reference board.

config ATH79_MACH_AP135
	bool "Qualcomm Atheros AP135 reference board"
	select SOC_QCA955X
	select ATH79_DEV_GPIO_BUTTONS
	select ATH79_DEV_LEDS_GPIO
	select ATH79_DEV_M25P80
	select ATH79_DEV_SPI
	select ATH79_DEV_USB
	select ATH79_DEV_WMAC
	select ATH79_DEV_ETH
	help
	  Say 'Y' here if you want your kernel to support the
	  Qualcomm Atheros AP135 reference board.

config ATH79_MACH_AP135_DUAL
	bool "Qualcomm Atheros AP135 Dual reference board"
	select SOC_QCA955X
	select ATH79_DEV_GPIO_BUTTONS
	select ATH79_DEV_LEDS_GPIO
	select ATH79_DEV_SPI
	select ATH79_DEV_USB
	select ATH79_DEV_NAND
	select ATH79_DEV_WMAC
	help
	  Say 'Y' here if you want your kernel to support the
	  Qualcomm Atheros AP135 Dual reference board.

config ATH79_MACH_AP137
	bool "Qualcomm Atheros AP137 reference board"
	select SOC_QCA955X
	select ATH79_DEV_GPIO_BUTTONS
	select ATH79_DEV_LEDS_GPIO
	select ATH79_DEV_M25P80
	select ATH79_DEV_SPI
	select ATH79_DEV_USB
	select ATH79_DEV_WMAC
	help
	  Say 'Y' here if you want your kernel to support the
	  Qualcomm Atheros AP135 reference board.

config ATH79_MACH_AP136
	bool "Atheros AP136/AP135 reference board"
	select SOC_QCA955X
	select ATH79_DEV_GPIO_BUTTONS
	select ATH79_DEV_LEDS_GPIO
	select ATH79_DEV_NFC
	select ATH79_DEV_SPI
	select ATH79_DEV_USB
	select ATH79_DEV_WMAC
	help
	  Say 'Y' here if you want your kernel to support the
	  Atheros AP136 or AP135 reference boards.

config ATH79_MACH_AP81
	bool "Atheros AP81 reference board"
	select SOC_AR913X
	select ATH79_DEV_ETH
	select ATH79_DEV_GPIO_BUTTONS
	select ATH79_DEV_LEDS_GPIO
	select ATH79_DEV_M25P80
	select ATH79_DEV_USB
	select ATH79_DEV_WMAC
	help
	  Say 'Y' here if you want your kernel to support the
	  Atheros AP81 reference board.

config ATH79_MACH_DB120
	bool "Atheros DB120 reference board"
	select SOC_AR934X
	select ATH79_DEV_AP9X_PCI if PCI
	select ATH79_DEV_ETH
	select ATH79_DEV_GPIO_BUTTONS
	select ATH79_DEV_LEDS_GPIO
	select ATH79_DEV_M25P80
	select ATH79_DEV_NFC
	select ATH79_DEV_USB
	select ATH79_DEV_WMAC
	help
	  Say 'Y' here if you want your kernel to support the
	  Atheros DB120 reference board.

config ATH79_MACH_PB44
	bool "Atheros PB44 reference board"
	select SOC_AR71XX
	select ATH79_DEV_ETH
	select ATH79_DEV_GPIO_BUTTONS
	select ATH79_DEV_LEDS_GPIO
	select ATH79_DEV_SPI
	select ATH79_DEV_USB
	help
	  Say 'Y' here if you want your kernel to support the
	  Atheros PB44 reference board.

config ATH79_MACH_UBNT_XM
	bool "Ubiquiti Networks XM/UniFi boards"
	select SOC_AR724X
	select SOC_AR934X
	select ATH79_DEV_AP9X_PCI if PCI
	select ATH79_DEV_ETH
	select ATH79_DEV_GPIO_BUTTONS
	select ATH79_DEV_LEDS_GPIO
	select ATH79_DEV_M25P80
	select ATH79_DEV_USB
	select ATH79_DEV_WMAC
	help
	  Say 'Y' here if you want your kernel to support the
	  Ubiquiti Networks XM (rev 1.0) board.

choice
	prompt "Build a DTB in the kernel"
	optional
	help
	  Select a devicetree that should be built into the kernel.

	config DTB_TL_WR1043ND_V1
		bool "TL-WR1043ND Version 1"
		select BUILTIN_DTB
		select SOC_AR913X
endchoice

source "arch/mips/ath79/Kconfig.openwrt"

endmenu

config SOC_AR71XX
	select HW_HAS_PCI
	def_bool n

config SOC_AR724X
	select HW_HAS_PCI
	select PCI_AR724X if PCI
	def_bool n

config SOC_AR913X
	def_bool n

config SOC_AR933X
	def_bool n

config SOC_AR934X
	select HW_HAS_PCI
	select PCI_AR724X if PCI
	def_bool n

config SOC_QCA953X
	select USB_ARCH_HAS_EHCI
	def_bool n

config SOC_QCA955X
	select HW_HAS_PCI
	select PCI_AR724X if PCI
	def_bool n

config SOC_QCA956X
	select USB_ARCH_HAS_EHCI
	select HW_HAS_PCI
	select PCI_AR724X if PCI
	def_bool n

config SOC_QCN550X
	select USB_ARCH_HAS_EHCI
	select HW_HAS_PCI
	select PCI_AR724X if PCI
	def_bool n

config ATH79_DEV_M25P80
	select ATH79_DEV_SPI
	def_bool n

config ATH79_DEV_AP9X_PCI
	select ATH79_PCI_ATH9K_FIXUP
	def_bool n

config ATH79_DEV_DSA
	def_bool n

config ATH79_DEV_ETH
	def_bool n

config PCI_AR724X
	def_bool n

config ATH79_DEV_GPIO_BUTTONS
	def_bool n

config ATH79_DEV_LEDS_GPIO
	def_bool n

config ATH79_DEV_NFC
	depends on (SOC_AR934X || SOC_QCA955X)
	def_bool n

config ATH79_DEV_NAND
	select ATH79_NAND_CALDATA_FIXUP
	def_bool n

config ATH79_DEV_SPI
	def_bool n

config ATH79_DEV_USB
	def_bool n

config ATH79_DEV_WMAC
	depends on (SOC_AR913X || SOC_AR933X || SOC_AR934X || SOC_QCA953X || SOC_QCA955X || SOC_QCA956X || SOC_QCN550X)
	def_bool n

config ATH79_NVRAM
	def_bool n

config ATH79_PCI_ATH9K_FIXUP
	def_bool n

config ATH79_ROUTERBOOT
	def_bool n

endif
```

## qca/src/linux-4.4/drivers/net/phy/qca_85xx/Kconfig
```kconfig
config	QCA_85XX_SWITCH
	tristate "Driver for 841x, 851x, 861x, 871x family of switches"
	select SWCONFIG
	---help---
	 Driver for 841x, 851x, 861x, 871x family of switches

config AQ_PHY
        tristate "Driver for Aquantia PHY"
        depends on MDIO_GPIO
        ---help---
        Supports the Aquantia PHY
```

## qca/src/linux-4.4/drivers/net/wireless/cnss2/Kconfig
```kconfig
config CNSS2
	bool "CNSS2 Platform Driver for Wi-Fi Module"
	---help---
	  This module adds the support for Connectivity Subsystem (CNSS) used
	  for PCIe based Wi-Fi devices with QCA6174/QCA6290 chipsets.
	  This driver also adds support to integrate WLAN module to subsystem
	  restart framework.

config CNSS2_DEBUG
	bool "CNSS2 Platform Driver Debug Support"
	depends on CNSS2
	---help---
	  This option is to enable CNSS2 platform driver debug support which
	  primarily includes providing additional verbose logs for certain
	  features, enabling kernel panic for certain cases to aid the
	  debugging, and enabling any other debug mechanisms.

config CNSS2_PM
	bool "CNSS2 power save support"
	depends on CNSS2
	---help---
	  This option is to enable power save support in cnss2

config CNSS2_PCI_DRIVER
	bool "CNSS2 pci driver support"
	depends on CNSS2
	---help---
	  This option is to enable cnss2 to register the PCI driver and
	  initialize the radios on its own

config CNSS2_CALIBRATION_SUPPORT
	bool "CNSS2 calibration support"
	depends on CNSS2
	---help---
	  This option is to enable cnss2 calibration support

config CNSS2_SMMU
	bool "CNSS2 smmu support"
	depends on CNSS2
	---help---
	  This option is to enable cnss2 smmu support

config CNSS2_RAMDUMP
	bool "CNSS2 ramdump support"
	depends on CNSS2
	---help---
	  This option is to enable cnss2 ramdump support
```
