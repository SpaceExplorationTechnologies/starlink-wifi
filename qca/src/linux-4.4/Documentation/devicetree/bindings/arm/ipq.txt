## qca/src/linux-4.4/Documentation/devicetree/bindings/net/qcom-nss-cryptov2.txt
```
* Qualcomm Technologies Inc. NSS CRYPTO Driver.

This driver is responsible for setting up the ipq807x crypto engine.
The driver is responsible for initialization of crypto engine, downloading
of crypto engine firmware, allocating a dma, setting up context record.

Required properties:
- compatible: "qcom,nss-crypto"
- qcom,max-contexts: Maximum number of supported context
- qcom,max-context-size: Maximum context size in words supported by HW.
- ranges: used when there is a reg_map in child node.

* eip197_node: This is the first child node that denotes that this driver supports eip197 crypto engine.

Required properties:
- compatible: "qcom,eip197".
- reg-names: Indicates various resources passed to driver by name.
- reg: physical address and length of the register set for the device.
- qcom,dma-mask: Max dma rings supported, each bit represent a ring number
- qcom,transform-enabled: Whether Packet for tranformation will be sent from host or not.
- qcom,aes128-cbc: Enable crypto algorithm
- qcom,aes192-cbc: Enable crypto algorithm
- qcom,aes256-cbc: Enable crypto algorithm
- qcom,aes128-ctr: Enable crypto algorithm
- qcom,aes192-ctr: Enable crypto algorithm
- qcom,aes256-ctr: Enable crypto algorithm
- qcom,3des-cbc: Enable crypto algorithm
- qcom,sha160-hash: Enable crypto algorithm
- qcom,sha224-hash: Enable crypto algorithm
- qcom,sha256-hash: Enable crypto algorithm
- qcom,sha384-hash: Enable crypto algorithm
- qcom,sha512-hash: Enable crypto algorithm
- qcom,sha160-hmac: Enable crypto algorithm
- qcom,sha256-hmac: Enable crypto algorithm
- qcom,sha384-hmac: Enable crypto algorithm
- qcom,sha512-hmac: Enable crypto algorithm
- qcom,aes128-gcm-gmac: Enable crypto algorithm
- qcom,aes192-gcm-gmac: Enable crypto algorithm
- qcom,aes256-gcm-gmac: Enable crypto algorithm
- qcom,aes128-cbc-sha160-hmac: Enable crypto algorithm
- qcom,aes192-cbc-sha160-hmac: Enable crypto algorithm
- qcom,aes256-cbc-sha160-hmac: Enable crypto algorithm
- qcom,aes128-ctr-sha160-hmac: Enable crypto algorithm
- qcom,aes192-ctr-sha160-hmac: Enable crypto algorithm
- qcom,aes256-ctr-sha160-hmac: Enable crypto algorithm
- qcom,3des-cbc-sha160-hmac: Enable crypto algorithm
- qcom,aes128-cbc-sha256-hmac: Enable crypto algorithm
- qcom,aes192-cbc-sha256-hmac: Enable crypto algorithm
- qcom,aes256-cbc-sha256-hmac: Enable crypto algorithm
- qcom,aes128-ctr-sha256-hmac: Enable crypto algorithm
- qcom,aes192-ctr-sha256-hmac: Enable crypto algorithm
- qcom,aes256-ctr-sha256-hmac: Enable crypto algorithm
- qcom,3des-cbc-sha256-hmac: Enable crypto algorithm

* engine0: First engine for EIP197 block. Some crypto HW can support multiple engine.

Required properties:
- reg_offset: offset within the base register for this engine.
- qcom,ifpp-enabled: Enable EIP classification core Firmware.
- qcom,ipue-enabled: Enable EIP classification core Firmware.
- qcom,ofpp-enabled: Enable EIP classification core Firmware.
- qcom,opue-enabled: Enable EIP classification core Firmware.

example:
	qcom,nss_crypto {
		compatible = "qcom,nss-crypto";
		qcom,max-contexts = <16>;
		qcom,max-context-size = <32>;
		ranges;

		eip197_node {
			compatible = "qcom,eip197";
			reg-names = "crypto_pbase";
			reg = <0x39800000 0x7ffff>;
			qcom,dma-mask = <0xff>;
			qcom,transform-enabled;
			qcom,aes128-cbc;
			qcom,aes192-cbc;
			qcom,aes256-cbc;
			qcom,3des-cbc;
			qcom,sha1-hmac;
			qcom,aes128-gcm-gmac;
			qcom,aes192-gcm-gmac;
			qcom,aes256-gcm-gmac;
			qcom,aes128-cbc-sha1-hmac;
			qcom,aes192-cbc-sha1-hmac;
			qcom,aes256-cbc-sha1-hmac;
			qcom,3des-cbc-sha1-hmac;
			qcom,aes128-cbc-sha256-hmac;
			qcom,aes192-cbc-sha256-hmac;
			qcom,aes256-cbc-sha256-hmac;
			qcom,3des-cbc-sha256-hmac;

			engine0 {
				reg_offset = <0x80000>;
				qcom,ifpp-enabled;
				qcom,ipue-enabled;
				qcom,ofpp-enabled;
				qcom,opue-enabled;
			};
		};
	};
```

## qca/src/linux-4.4/Documentation/devicetree/bindings/net/qcom-nss-dp.txt
```
* Qualcomm Technologies Inc. NSS Data Plane Platform Driver.

Master data plane driver for the QCA networking subsystem (NSS)

Required properties:
- device_type: = "network";
- compatible: = should be "qcom,nss-dp";
- qcom,id: Unique Identifier for the GMAC block. This field is unique identifier
		for each physical port.
- reg: Base address and size for the Qcom/Synopsys Mac Register space
- qcom,mactype: = 0 for Qcom GMAC, 1 for Synopsys GMAC.
- local-mac-address: MAC Address to be used at the time of interface
			initialization



Example:

dp1 {
	device_type = "network";
	compatible = "qcom,nss-dp";
	qcom,id = <1>;
	reg = <0x3a001000 0x200>;
	qcom,mactype = <0>;
	local-mac-address = [000000000000];
};


Required properties:
- compatible: = should be "qcom,edma";
- reg: Base address and size for the Qcom/Synopsys Mac Register space
- reg-names: Namespace of registers
- qcom,txdesc-ring-start: TX descriptor start ring number
- qcom,txdesc-rings: Total number TX descriptor rings used from TX descriptor start ring number
- qcom,txcmpl-ring_start: TX completion descriptor ring number start
- qcom,txcmpl-rings: Total number TX completion descriptor rings used from TX completion descriptor start ring number
- qcom,rxfill-ring_start: RX fill ring start number
- qcom,rxfill-rings: Total number RX fill rings used from RX receive ring start number
- qcom,rxdesc-ring_start: RX receive ring start number
- qcom,rxdesc-rings: Total number RX rings used from RX receive ring start number
- interrupts: Interrupt number used for txcmpl_ring, rxfill_ring, rxdesc_ring and misc interrupt in that order




edma@3ab00000 {
	compatible = "qcom,edma";
	reg = <0x3ab00000 0x76900>;
	reg-names = "edma-reg-base";
	qcom,txdesc-ring-start = <23>;
	qcom,txdesc-rings = <1>;
	qcom,txcmpl-ring-start = <7>;
	qcom,txcmpl-rings = <1>;
	qcom,rxfill-ring-start = <7>;
	qcom,rxfill-rings = <1>;
	qcom,rxdesc-ring-start = <15>;
	qcom,rxdesc-rings = <1>;
	interrupts = <0 345 4>,
		   <0 353 4>,
		   <0 361 4>,
		   <0 344 4>;
};
```

## qca/src/linux-4.4/Documentation/devicetree/bindings/net/qcom-nss-drv.txt
```
* Qualcomm Technologies Inc. NSS HLOS Platform Driver.

This driver communicates with the NSS Firmware, and provides empty buffers for
packet-processing to the UBI32 processor.
It also keeps track of sync packets from NSS Firmware.
This driver has 2 sections listed below, one common to all the UBI32 cores and
other specific to each UBI32 core.

1. Driver access details specific to each UBI32/NSS core.

Required properties:
- compatible: "qcom,nss"
- interrupts: UBI32 to Apps interrupts for Sync/Data Packets and Empty Buffers.
- reg-names: Indicates various resources passed to driver by name.
		"nphys","vphys"
		Refers to TCM and CSM Base Addresses of UBI32 Memory map.
- reg: physical address and length of the register set for the device.
- qcom,id: Unique Identifier for the HLOS block.This field is unique identifier
	   for the core, which is also used as an index for global nss context.
- clocks: physical address for NSS source clock, TCM clock and fabric clock.
- resets: physical address for core clock reset, AHB and AXI reset.
- qcom,load-addr: physical address to load NSS firmware.
- qcom,num-queue: how many UBI32 to Apps queue enabled.
- qcom,turbo-frequency = turbo freq supported or not.
- qcom,low-frequency = lowest supported operating frequency.
- qcom,mid-frequency = nominal supported operating frequency.
- qcom,max-frequency = maximum supported operating frequency.

Optional properties:

Each of the following properity indicates that a specific feature is enabled on
this UBI32 core that allows data/stats commnicatin with the Apps CPU

- qcom,capwap-enabled
- qcom,crypto-enabled
- qcom,dtls-enabled
- qcom,gre-redir-enabled
- qcom,ipsec-enabled
- qcom,ipv4-enabled
- qcom,ipv4-reasm-enabled
- qcom,ipv6-enabled
- qcom,ipv6-reasm-enabled
- qcom,l2tpv2-enabled
- qcom,map-t-enabled
- qcom,oam-enabled
- qcom,pppoe-enabled
- qcom,pptp-enabled
- qcom,portid-enabled
- qcom,shaping-enabled
- qcom,tstamp-enabled
- qcom,turbo-frequency
- qcom,tun6rd-enabled
- qcom,tunipip6-enabled
- qcom,wlanredirect-enabled
- qcom,wlan-dataplane-offload-enabled

example:
nss0: nss@40000000 {
	compatible = "qcom,nss";
	pinctrl-0 = <&nss_spi_pins>;
	pinctrl-names = "default";
	interrupts = <GIC_SPI 213 IRQ_TYPE_LEVEL_HIGH
		GIC_SPI 232 IRQ_TYPE_LEVEL_HIGH>;
	reg = <0x36000000 0x1000 0x39000000 0x10000>;
	reg-names = "nphys", "vphys";
	clocks = <&gcc NSS_CORE_CLK>, <&gcc NSSTCM_CLK_SRC>, <&gcc NSSTCM_CLK>,
		 <&nss_fabric0_clk>, <&nss_fabric1_clk>;
	clock-names = "nss-core-clk", "nss-tcm-src", "nss-tcm-clk",
		      "nss-fab0-clk", "nss-fab1-clk";
	resets = <&gcc UBI32_CORE1_CLKRST_CLAMP_RESET>,
		<&gcc UBI32_CORE1_CLAMP_RESET>,
		<&gcc UBI32_CORE1_AHB_RESET>,
		<&gcc UBI32_CORE1_AXI_RESET>;
	reset-names = "clkrst-clamp", "clamp", "ahb", "axi";
	qcom,id = <0>;
	qcom,num-irq = <2>;
	qcom,num-queue = <2>;
	qcom,load-addr = <0x40000000>;
	qcom,turbo-frequency = <1>;
	qcom,low-frequency = <110000000>;
	qcom,mid-frequency = <550000000>;
	qcom,max-frequency = <733000000>;
	qcom,ipv4-enabled;
	qcom,ipv6-enabled;
	qcom,wlanredirect-enabled;
	qcom,tun6rd-enabled;
	qcom,tunipip6-enabled;
	qcom,shaping-enabled;
	qcom,wlan-dataplane-offload-enabled;
};

nss1: nss@40800000 {
	compatible = "qcom,nss";
	interrupts = <GIC_SPI 214 IRQ_TYPE_LEVEL_HIGH
			  GIC_SPI 233 IRQ_TYPE_LEVEL_HIGH>;
	reg = <0x36400000 0x1000 0x39010000 0x10000>;
	reg-names = "nphys", "vphys";
	resets = <&gcc UBI32_CORE2_CLKRST_CLAMP_RESET>,
		 <&gcc UBI32_CORE2_CLAMP_RESET>,
		 <&gcc UBI32_CORE2_AHB_RESET>,
		 <&gcc UBI32_CORE2_AXI_RESET>;
	reset-names = "clkrst-clamp", "clamp", "ahb", "axi";
	qcom,id = <1>;
	qcom,num-irq = <2>;
	qcom,num-queue = <2>;
	qcom,load-addr = <0x40800000>;
	qcom,turbo-frequency = <1>;
	qcom,low-frequency = <110000000>;
	qcom,mid-frequency = <550000000>;
	qcom,max-frequency = <733000000>;
	qcom,crypto-enabled;
	qcom,ipsec-enabled;
};
```

## qca/src/linux-4.4/Documentation/devicetree/bindings/net/qcom-nss-macsec.txt
```
* Qualcomm Technologies Inc. NSS MAC Security Engine Driver.

This driver configures PHY Security Engine on the board.

1. Driver access details to each PHY Security Engine

Required properties:
- device_type: = "network";
- compatible: = should be "qcom,nss-macsec";
- phy_addr:  physical phy address for the device.
- phy_access_mode: 0 means mdio access, 1 means i2c access.

Optional properties:

Example:
nss-macsec0 {
	compatible = "qcom,nss-macsec";
	phy_addr = <0x1c>;
	phy_access_mode = <0>;
};
```

## qca/src/linux-4.4/Documentation/devicetree/bindings/net/qcom-ssdk.txt
```
* Qualcomm Technologies Inc. SSDK Driver.


Required properties:
- compatible: = should be "qcom,ess-switch-ipq807x";
- reg: Base address and size for the ess-switch register space
- switch_access_mode: should be "local bus"
- switch_mac_mode: should be "0-0xe" or "0xff"
- switch_mac_mode1: should be "0-0xe" or "0xff"
- switch_mac_mode2: should be "0-0xe" or "0xff"

Example:

ess-switch@3a000000 {
	compatible = "qcom,ess-switch-ipq807x";
	reg = <0x3a000000 0x1000000>;
	switch_access_mode = "local bus";
	switch_mac_mode = <0x0>;
	switch_mac_mode1 = <0xff>;
	switch_mac_mode2 = <0xd>;
};

Required properties:
- compatible: = should be "qcom,ess-uniphy";
- reg: Base address and size for the ess-uniphy register space
- uniphy_access_mode: should be "local bus"

Example:

ess-uniphy@7a00000 {
	compatible = "qcom,ess-uniphy";
	reg = <0x7a00000 0x30000>;
	uniphy_access_mode = "local bus";
};
```

## qca/src/linux-4.4/Documentation/devicetree/bindings/nvmem/qfprom.txt
```
= Qualcomm QFPROM device tree bindings =

This binding is intended to represent QFPROM which is found in most QCOM SOCs.

Required properties:
- compatible: should be "qcom,qfprom"
- reg: Should contain registers location and length
 OR
- compatible: should be "qcom,qfprom-sec"
	This binding is intended for secure boot qfprom driver

= Data cells =
Are child nodes of qfprom, bindings of which as described in
bindings/nvmem/nvmem.txt

Example:

	qfprom: qfprom@00700000 {
		compatible 	= "qcom,qfprom";
		reg		= <0x00700000 0x8000>;
		...
		/* Data cells */
		tsens_calibration: calib@404 {
			reg = <0x4404 0x10>;
		};
	};

	qfprom {
		compatible = "qcom,qfprom-sec";
	};


= Data consumers =
Are device nodes which consume nvmem data cells.

For example:

	tsens {
		...
		nvmem-cells = <&tsens_calibration>;
		nvmem-cell-names = "calibration";
	};
```

## qca/src/linux-4.4/Documentation/devicetree/bindings/pci/qca,ar724x-pci.txt
```
Qualcomm Atheros AR724x PCI

Qualcomm Atheros AR724x PCI root complex

Required properties:
  - compatible: should be "qca, ar724x-pci"
  - reg: should contain PCIe register maps.
  - reg-names: indicates various resources passed to driver by name.
		Should be "cfg_base", "ctrl_base", "crp_base", "mem_base", "io_base".
		These correspond to different modules within the PCIe core.
  - interrupts: Should be in the format <0> and it is an index to the
		interrupt-map that contains PCIe related interrupts.
  - interrupt-parent: Indicates the interrupt controller where the PCI interrupt
			belongs.

Example:

	pci: pci@0x16000000 {
		compatible = "qca,ar724x-pci";
		reg = <0x16000000 0x1000>,
			<0x18280000 0x100>,
			<0x18250000 0x1000>,
			<0x12000000 0x02000000>,
			<1 1>;
		reg-names = "cfg_base","ctrl_base","crp_base",
				"mem_base","io_base";
		interrupt-parent = <&ip2_int>;
		interrupts = <0>;
		status = "okay";
	};
```
