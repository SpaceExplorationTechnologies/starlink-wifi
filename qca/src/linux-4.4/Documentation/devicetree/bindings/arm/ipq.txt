## qca/src/linux-4.4/Documentation/devicetree/bindings/arm/ipq.txt
```
QCA IPQ device tree bindings
------------------------------

System on Chip

Device tree must specify which SoC it uses, with one of the following
compatible strings

	"qcom,ipq807x"
	"qcom,ipq8064"
	"qcom,ipq8062"
Platform

Device tree must specify which Platform it uses, with one of the following
compatible strings
	"qcom,ipq807x-hk01"
	"qcom,ipq807x-hk02"
	"qcom,ipq807x-hk07"
	"qcom,ipq807x-hk08"
	"qcom,ipq807x-hk09"
	"qcom,ipq807x-ac01.1"
	"qcom,ipq807x-ac01.2"
	"qcom,ipq8064-ap160"
	"qcom,ipq8064-ap160_2xx"
	"qcom,ipq8064-ap161"
	"qcom,ipq8064-db149"
	"qcom,ipq8062-ap145"
	"qcom,ipq8062-ap145_1xx"
	"qcom,ipq8064-ap148"
	"qcom,ipq8064-ap148_1xx"
```

## qca/src/linux-4.4/Documentation/devicetree/bindings/arm/msm/qcom,pvs.txt
```
Qualcomm Process Voltage Scaling Tables

The node name is required to be "qcom,pvs". There shall only be one
such node present in the root of the tree.

PROPERTIES

- qcom,pvs-format-a or qcom,pvs-format-b:
	Usage: required
	Value type: <empty>
	Definition: Indicates the format of qcom,speedX-pvsY-bin-vZ properties.
		    If qcom,pvs-format-a is used the table is two columns
		    (frequency and voltage in that order). If qcom,pvs-format-b 		    is used the table is three columns (frequency, voltage,
		    and current in that order).

- qcom,speedX-pvsY-bin-vZ:
	Usage: required
	Value type: <prop-encoded-array>
	Definition: The PVS table corresponding to the speed bin X, pvs bin Y,
		    and version Z.
Example:

	qcom,pvs {
		qcom,pvs-format-a;
		qcom,speed0-pvs0-bin-v0 =
			<  384000000  950000 >,
			<  486000000  975000 >,
			<  594000000 1000000 >,
			<  702000000 1025000 >,
			<  810000000 1075000 >,
			<  918000000 1100000 >,
			< 1026000000 1125000 >,
			< 1134000000 1175000 >,
			< 1242000000 1200000 >,
			< 1350000000 1225000 >,
			< 1458000000 1237500 >,
			< 1512000000 1250000 >;
	};
```

## qca/src/linux-4.4/Documentation/devicetree/bindings/cache/qcom_cache_dump.txt
```
* Qualcomm Krait L1 / L2 cache dumping device
This is a virtual device that dumps the contents of L1 and L2 caches in the
event of a kernel panic or a watchdog trigger.

Required properties:
- compatible:			Should be "qcom,cache_dump"
- qcom,l1-dump-size:	Amount of memory needed for L1 dump(s), in bytes
- qcom,l2-dump-size:	Amount of memory needed for L2 dump, in bytes

Example:
	qcom,cache_dump {
		compatible = "qcom,cache_dump";
		qcom,l1-dump-size = <0x100000>;
		qcom,l2-dump-size = <0x200000>;
	};
```

## qca/src/linux-4.4/Documentation/devicetree/bindings/clock/qca,apss.txt
```
QCA APSS Clock Controller Binding
------------------------------------------------

Required properties :
- compatible : shall contain only one of the following:

			"qcom,apss-ipq807x"

- reg : shall contain base register location and length
- #clock-cells : shall contain 1
- #reset-cells : shall contain 1

Optional properties :
- #power-domain-cells : shall contain 1

Example:
	clock-controller@900000 {
		compatible = "qcom,apss-ipq807x";
		reg = <0x900000 0x4000>;
		#clock-cells = <1>;
		#reset-cells = <1>;
		#power-domain-cells = <1>;
	};
```

## qca/src/linux-4.4/Documentation/devicetree/bindings/clock/qcom,fab-scaling.txt
```
Qualcomm Atheros DDR and APPS FABRICS scaling
------------------------------------------------

Required properties :
- compatible : "qcom,fab-scaling"
- clocks : defines each clock needed
- clock-names : contains clock names
- fab_freq_high : Turbo FABRIC frequency
- fab_freq_nominal : Nominal FABRIC frequency

Example:

fab-scaling {
	compatible = "qcom,fab-scaling";
	clocks = <&apps_fabric_clk>, <&ebi1_clk>;
	clock-names = "apps-fab-clk", "ddr-fab-clk";
	fab_freq_high = <533000000>;
	fab_freq_nominal = <400000000>;
};
```

## qca/src/linux-4.4/Documentation/devicetree/bindings/display/qcom,qpic-fb.txt
```
* QPIC LCD node

Required properties:
- compatible:		"qcom,mdss_qpic"
- reg:			QPIC LCD register address range
- clocks:		must contain core clock and always on clock
- clock-names:		must contain "core" for the core clock and "aon" for the
			always on clock
- dmas:			DMA specifier, consisting of a phandle BAM DMA
			controller node and the channel number to
			be used for LCD. Refer to dma.txt and
			qcom_bam_dma.txt for more details
Optional properties:
- qcom,bam_timeout:	Timeout in ms for QPIC BAM transfer. Default timeout
			i.e. 400 ms will be used if this parameter is not
			present.

Example:

qcom_mdss_qpic@7980000 {
	compatible = "qcom,mdss_qpic";
	reg = <0x7980000 0x24000>;
	interrupts = <0 106 0>;
	clocks = <&gcc GCC_QPIC_CLK>, <&gcc GCC_QPIC_AHB_CLK>;
	clock-names = "core", "aon";
	dmas = <&qpic_bam 6>;
	qcom,bam_timeout = <1000>;
};

* QPIC LCD Display Panel

Required properties:
- compatible:		"qcom,mdss-qpic-panel"
- label:		QPIC LCD Panel Name
- qcom,mdss-pan-res:	QPIC LCD Display Panel resolution in x,y
- qcom,mdss-pan-bpp:	QPIC LCD Display Panel bits per pixel
- qcom,refresh_rate:	QPIC LCD Display Panel refresh rate

Example:

qcom_mdss_qpic_panel {
	compatible = "qcom,mdss-qpic-panel";
	label = "qpic lcd panel";
	qcom,mdss-pan-res = <800 480>;
	qcom,mdss-pan-bpp = <18>;
	qcom,refresh_rate = <60>;
	status = "disabled";
};
```

## qca/src/linux-4.4/Documentation/devicetree/bindings/input/touchscreen/gsl1680.txt
```
* GSL1680, 1680 Capacitive Touchscreen Controller

Required properties:
- compatible: must be "gsl1680_ts"
- reg: slave address of touch screen controller.
- status : enabled or disabled.

Example:
	lcd_ts: lcd_ts@40 {
		compatible = "qca,gsl1680_ts"
		reg = <0x40;
		status = "disabled"
	};
```

## qca/src/linux-4.4/Documentation/devicetree/bindings/leds/leds-ipq.txt
```
QCA LED Controller Driver.

Required properties:
- compatible: "qca,ledc"
- reg: Base address for LED registers.
- reg-names: Register name for reference.
- qcom,tcsr_ledc_values: The values with which the 12 LED Control registers needs to be initialized with.
- qcom,ledc_blink_indices_cnt: No.of blink registers configured. Allowed value is 0 to 4.
- qcom,ledc_blink_indices: Indices of LEDs which are configured as blink LEDs. No. of entries
                        should correspond to the value in qcom,ledc_blink_indices_cnt.

Optional properties:
- qcom,ledc_blink_idx_src_pair: List of LED index + blink source pairs.

Examples:

qcom: ledc@1937000 {
	compatible = "qca,ledc";
	reg = <0x1937000 0x20070>;
	reg-names = "ledc_base_addr";
	qcom,tcsr_ledc_values = <0x320195 0xA418820 0x16A4A0E6 0x2307B9AC 0x16AD272 \
		0xFFFFFFFF 0x0 0x0 0x7D006F 0x0 0x10482090 0x3FFFFE4>;
	qcom,ledc_blink_indices_cnt = <4>;
	qcom,ledc_blink_indices = <19 20 21 22>;
	qcom,ledc_blink_idx_src_pair = <3 20>, <4 21>, <5 22>;
};
```

## qca/src/linux-4.4/Documentation/devicetree/bindings/net/qca-ag71xx.txt
```
* QCA MDIO IO device

Required properties:
- compatible : Should be "qca,ag71xx-mdio"
- reg : Address and length of the register set for the device
- reset-bit: Reset bitmap for mdio device

Optional properties:
- phy-mask: phy address mask
- builtin-switch: 0: unsupport, 1: support
- ar934x-support: 0: unsupport, 1: support

Example:

mdio0: mdio@19000000 {
	compatible = "qca,ag71xx-mdio";
	reg = <0x19000000 0x200>;
	phy-mask = <0>;
	builtin-switch = <0>;
	ar934x-support = <0>;
	reset-bit = <0x400000>;
	phy0: ethernet-phy@0 {
		reg = <0>;
		qca,ar8327-initvals = <
			0x00004 0x80080     /* PAD0_MODE */
			0x00008 0x0000000   /* PAD5_MODE */
			0x0000c 0x7600000   /* PAD6_MODE */
			0x000e4 0x2a545     /* MAC_POWER_SEL */
			0x000e0 0xc74164d0  /* SGMII_CTRL */
			0x0007c 0x7e        /* PORT0_STATUS */
			0x00094 0x7e        /* PORT6_STATUS */
		>;
	};
	phy1: ethernet-phy@1 {
		reg = <1>;
	};
	phy2: ethernet-phy@2 {
		reg = <2>;
	};
	phy3: ethernet-phy@3 {
		reg = <3>;
	};
	phy4: ethernet-phy@4 {
		reg = <4>;
	};
};

* QCA ag71xx Ethernet driver

Required properties:
- compatible : Should be "qca,ag71xx-eth"
- reg : Address and length of the register set for the device
- reg-names : Memory resource name
- reset-bit : Rest bitmap for this device
- interrupts : Interrupt resourse
- interrupt-names : Interrupt resource name
- mdio-handle : The phandle for the PHY connected to this ethernet controller

Optional properties:
- eth-cfg : The value is to configure GMAC Register(ETH_CFG), the bit definition
            is different of platforms, refer to the user manual for detail.
- phy-mode : < phy_mode> phy_mask speed duplex>
            phy_mode: 0 invalid, 1 MII, 2 GMII, 3 SGMII, 4 TBI, 5 RMII, 6 RGMII,
                         7 RGMII_ID, 8 RGMII_RXID, 9 RGMII_TXID, 10 RTBI, 11 SMII
- phy_mask: Phy mask
- force-speed :  10 10M, 100 100M, 1000 1000M
- force-duplex : 0 half, 1 full
- fifo-cfg : <fifo_cfg1 fifo_cfg2 fifo_cfg3>
            The values of fifo Registers, refer to user manual for detail.
- eth-pll-data : <pll_10 pll_100 pll_1000>
            The values of pll Registers, refer to user manual for detail.
- builtin-switch :  <phy4_mii_en phy_poll_mask>
            phy4_mii_en: Enable phy4 MII
            phy_poll_mask: Phy polling mask

Example:

eth0: ethernet@19000000 {
	compatible = "qca,ag71xx-eth";
	reg = <0x19000000 0x200>,
		<0x18070000 0x14>;
	reg-names = "mac_base",
		    "cfg_base";
	mdio-handle = <&mdio0>;
	eth-pll-data = <0x1313 0 0x86000000>;
	phy-mode = <7>;
	phy-mask = <1>;
	force-speed = <1000>;
	force-duplex = <1>;
	max-frame-len = <4095>;
	desc-pktlen-mask = <0x3fff>;
	reset-bit = <0x200>;
	has-gbit = <1>;
	ar724x-support = <1>;
	qca955x-support = <1>;
	fifo-cfg = <0x0010ffff 0x015500aa 0x01f00140>;
	interrupts = <4>;
	interrupt-names = "mac_irq";
};
```

## qca/src/linux-4.4/Documentation/devicetree/bindings/net/qca-edma.txt
```
QCA Edma Module
----------------------

This driver adds support for the Edma module

1. QCA Ethernet DMA
----------------------

Required properties:
  - compatible = "qcom,ess-edma";

Optional properties:

Example:
    edma@c080000 {
	compatible = "qcom,ess-edma";
	reg = <0xc080000 0x8000>;
	qcom,page-mode = <0>;
	qcom,rx-head-buf-size = <1540>;
	qcom,num-gmac = <2>;
	interrupts = <0 65 1>,
		   <0 66 1>,
		   <0 67 1>,
		   <0 68 1>,
		   <0 69 1>,
		   <0 70 1>,
		   <0 71 1>,
		   <0 72 1>,
		   <0 73 1>,
		   <0 74 1>,
		   <0 75 1>,
		   <0 76 1>,
		   <0 77 1>,
		   <0 78 1>,
		   <0 79 1>,
		   <0 80 1>,
		   <0 240 1>,
		   <0 241 1>,
		   <0 242 1>,
		   <0 243 1>,
		   <0 244 1>,
		   <0 245 1>,
		   <0 246 1>,
		   <0 247 1>,
		   <0 248 1>,
		   <0 249 1>,
		   <0 250 1>,
		   <0 251 1>,
		   <0 252 1>,
		   <0 253 1>,
		   <0 254 1>,
		   <0 255 1>;

		gmac0 {
                                local-mac-address = [000000000000];
                                qcom,phy-mdio-addr = <4>;
                                qcom,poll-required = <1>;
                                qcom,forced-speed = <1000>;
                                qcom,forced-duplex = <1>;
                                vlan-tag = <2 0x20>;
                        };
                gmac1 {
                                local-mac-address = [000000000000];
                                vlan-tag = <1 0x1e>;
                        };

   };
```

## qca/src/linux-4.4/Documentation/devicetree/bindings/net/qca-ess.txt
```
QCA Ethernet Subsystem
----------------------

This driver adds support for the Ethernet subsystem

1. QCA Ethernet DMA
----------------------

Required properties:
  - compatible = "qcom,ess-edma";

Optional properties:

Example:
    edma@c080000 {
	compatible = "qcom,ess-edma";
	reg = <0xc080000 0x8000>;
	qcom,page-mode = <0>;
	qcom,rx_head_buf_size = <1540>;
	qcom,port_id_wan = <0x5>;
	interrupts = <0 65 1>,
		   <0 66 1>,
		   <0 67 1>,
		   <0 68 1>,
		   <0 69 1>,
		   <0 70 1>,
		   <0 71 1>,
		   <0 72 1>,
		   <0 73 1>,
		   <0 74 1>,
		   <0 75 1>,
		   <0 76 1>,
		   <0 77 1>,
		   <0 78 1>,
		   <0 79 1>,
		   <0 80 1>,
		   <0 240 1>,
		   <0 241 1>,
		   <0 242 1>,
		   <0 243 1>,
		   <0 244 1>,
		   <0 245 1>,
		   <0 246 1>,
		   <0 247 1>,
		   <0 248 1>,
		   <0 249 1>,
		   <0 250 1>,
		   <0 251 1>,
		   <0 252 1>,
		   <0 253 1>,
		   <0 254 1>,
		   <0 255 1>;
   };

2. QCA Ethernet Switch
----------------------

Required properties:
  - compatible = "qcom,ess-switch";

Optional properties:

Example:

	ess-switch@c000000 {
		compatible = "qcom,ess-switch";
		reg = <0xc000000 0x80000>; /* 512KB */
		switch_access_mode = "local bus";
		resets = <&gcc ESS_RESET>;
		switch_cpu_bmp = <0x1>;  /* cpu port bitmap */
		switch_lan_bmp = <0x1e>; /* lan port bitmap */
		switch_wan_bmp = <0x20>; /* wan port bitmap */
	};

3. QCA Ethernet PHY mode
-------------------------

Required properties:
  - compatible = "qcom,ess-psgmii";

Optional properties:

Example:

	ess-psgmii@98000 {
		compatible = "qcom,ess-psgmii";
		reg = <0x98000 0x800>; /* 2k */
		psgmii_access_mode = "local bus";
	};

4. MDIO Interface
----------------------

Required properties:
  - compatible = "qcom,ipq40xx-mdio";

Optional properties:

Example:

	mdio@90000 {
		#address-cells = <1>;
		#size-cells = <1>;
		compatible = "qcom,ipq40xx-mdio", "qcom,qca-mdio";
		reg = <0x90000 0x64>;
	};
```

## qca/src/linux-4.4/Documentation/devicetree/bindings/net/qcom-nss-crypto.txt
```
* Qualcomm Technologies Inc. Crypto Platform Driver.

This driver configures the crypto engine for IPSec traffic in UBI32.

Required properties:
- compatible: Should be qcom,nss-crypto
- reg: Physical address and length of the register set for the device.
- resets: physical address for crypto reset registe
- qcom,ee: Number of interrupt lines(Execution Environments) supported by BAM.

Example:

crypto0: crypto@38000000 {
	»        compatible = "qcom,nss-crypto";
		»        reg-names = "crypto_pbase", "bam_base";
		»        reg = <0x38000000 0x20000>,
		»            <0x38004000 0x22000>;
		»        resets = <&gcc CRYPTO_ENG2_RESET>;
		»        reset-names = "rst_eng";
		»        qcom,ee = <0>;
};
```
