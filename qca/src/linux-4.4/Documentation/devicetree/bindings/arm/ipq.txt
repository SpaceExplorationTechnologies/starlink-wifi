## qca/src/linux-4.4/Documentation/devicetree/bindings/pci/qcom,pcie.txt
```
* Qualcomm PCI express root complex

- compatible:
	Usage: required
	Value type: <stringlist>
	Definition: Value shall include
		    - "qcom,pcie-ipq8064" for ipq8064
		    - "qcom,pcie-apq8064" for apq8064
		    - "qcom,pcie-apq8084" for apq8084
		    - "qcom,pcie-ipq4019" for ipq4019
		    - "qcom,pcie-ipq807x" for ipq807x

- reg:
	Usage: required
	Value type: <prop-encoded-array>
	Definition: Register ranges as listed in the reg-names property

- reg-names:
	Usage: required
	Value type: <stringlist>
	Definition: Must include the following entries
		    - "parf"   Qualcomm specific registers
		    - "dbi"    Designware PCIe registers
		    - "elbi"   External local bus interface registers
		    - "config" PCIe configuration space

- device_type:
	Usage: required
	Value type: <string>
	Definition: Should be "pci". As specified in designware-pcie.txt

- #address-cells:
	Usage: required
	Value type: <u32>
	Definition: Should be set to 3. As specified in designware-pcie.txt

- #size-cells:
	Usage: required
	Value type: <u32>
	Definition: Should be set 2. As specified in designware-pcie.txt

- ranges:
	Usage: required
	Value type: <prop-encoded-array>
	Definition: As specified in designware-pcie.txt

- interrupts:
	Usage: required
	Value type: <prop-encoded-array>
	Definition: MSI interrupt

- interrupt-names:
	Usage: required
	Value type: <stringlist>
	Definition: Should contain "msi"

- #interrupt-cells:
	Usage: required
	Value type: <u32>
	Definition: Should be 1. As specified in designware-pcie.txt

- interrupt-map-mask:
	Usage: required
	Value type: <prop-encoded-array>
	Definition: As specified in designware-pcie.txt

- interrupt-map:
	Usage: required
	Value type: <prop-encoded-array>
	Definition: As specified in designware-pcie.txt

- clocks:
	Usage: required
	Value type: <prop-encoded-array>
	Definition: List of phandle and clock specifier pairs as listed
		    in clock-names property

- clock-names:
	Usage: required
	Value type: <stringlist>
	Definition: Should contain the following entries
		    * should be populated for v0 and v1
		    	- "iface"      Configuration AHB clock

		    * should be populated for v0
		    	- "core"       Clocks the pcie hw block
		    	- "phy"        Clocks the pcie PHY block

		    * should be populated for v1
			- "aux"        Auxiliary (AUX) clock
		    	- "bus_master" Master AXI clock
		    	- "bus_slave"  Slave AXI clock

- resets:
	Usage: required
	Value type: <prop-encoded-array>
	Definition: List of phandle and reset specifier pairs as listed
		    in reset-names property

- reset-names:
	Usage: required
	Value type: <stringlist>
	Definition: Should contain the following entries
		    * should be populated for v0
			- "axi"  AXI reset
			- "ahb"  AHB reset
			- "por"  POR reset
			- "pci"  PCI reset
			- "phy"  PHY reset

		    * should be populated for v1
			- "core" Core reset

- power-domains:
	Usage: required (for v1 only)
	Value type: <prop-encoded-array>
	Definition: A phandle and power domain specifier pair to the
		    power domain which is responsible for collapsing
		    and restoring power to the peripheral

- <name>-supply:
	Usage: required
	Value type: <phandle>
	Definition: List of phandles to the power supply regulator(s)
		    * should be populated for v0 and v1
			- "vdda"        core analog power supply

		    * should be populated for v0
			- "vdda_phy"    analog power supply for PHY
			- "vdda_refclk" analog power supply for IC which generate
					reference clock

- phys:
	Usage: required (for v1 only)
	Value type: <phandle>
	Definition: List of phandle(s) as listed in phy-names property

- phy-names:
	Usage: required (for v1 only)
	Value type: <stringlist>
	Definition: Should contain "pciephy"

- <name>-gpio:
	Usage: optional
	Value type: <prop-encoded-array>
	Definition: List of phandle and gpio specifier pairs. Should contain
		    - "perst"  PCIe endpoint reset signal line
		    - "pewake" PCIe endpoint wake signal line

- pinctrl-0:
	Usage: required
	Value type: <phandle>
	Definition: List of phandles pointing at a pin(s) configuration

- pinctrl-names
	Usage: required
	Value type: <stringlist>
	Definition: List of names of pinctrl-0 state

* Example for v0
	pcie0: pci@1b500000 {
		compatible = "qcom,pcie-ipq8064";
		reg = <0x1b500000 0x1000
		       0x1b502000 0x80
		       0x1b600000 0x100
		       0x0ff00000 0x100000>;
		reg-names = "dbi", "elbi", "parf", "config";
		device_type = "pci";
		linux,pci-domain = <0>;
		bus-range = <0x00 0xff>;
		num-lanes = <1>;
		#address-cells = <3>;
		#size-cells = <2>;
		ranges = <0x81000000 0 0	  0x0fe00000 0 0x00100000   /* I/O */
			  0x82000000 0 0x00000000 0x08000000 0 0x07e00000>; /* memory */
		interrupts = <GIC_SPI 35 IRQ_TYPE_NONE>;
		interrupt-names = "msi";
		#interrupt-cells = <1>;
		interrupt-map-mask = <0 0 0 0x7>;
		interrupt-map = <0 0 0 1 &intc 0 36 IRQ_TYPE_LEVEL_HIGH>, /* int_a */
				<0 0 0 2 &intc 0 37 IRQ_TYPE_LEVEL_HIGH>, /* int_b */
				<0 0 0 3 &intc 0 38 IRQ_TYPE_LEVEL_HIGH>, /* int_c */
				<0 0 0 4 &intc 0 39 IRQ_TYPE_LEVEL_HIGH>; /* int_d */
		clocks = <&gcc PCIE_A_CLK>,
			 <&gcc PCIE_H_CLK>,
			 <&gcc PCIE_PHY_CLK>;
		clock-names = "core", "iface", "phy";
		resets = <&gcc PCIE_ACLK_RESET>,
			 <&gcc PCIE_HCLK_RESET>,
			 <&gcc PCIE_POR_RESET>,
			 <&gcc PCIE_PCI_RESET>,
			 <&gcc PCIE_PHY_RESET>;
		reset-names = "axi", "ahb", "por", "pci", "phy";
	};

* Example for v1
	pcie0@fc520000 {
		compatible = "qcom,pcie-apq8084";
		reg = <0xfc520000 0x2000>,
		      <0xff000000 0x1000>,
		      <0xff001000 0x1000>,
		      <0xff002000 0x2000>;
		reg-names = "parf", "dbi", "elbi", "config";
		device_type = "pci";
		linux,pci-domain = <0>;
		bus-range = <0x00 0xff>;
		num-lanes = <1>;
		#address-cells = <3>;
		#size-cells = <2>;
		ranges = <0x81000000 0 0          0xff200000 0 0x00100000   /* I/O */
			  0x82000000 0 0x00300000 0xff300000 0 0x00d00000>; /* memory */
		interrupts = <GIC_SPI 243 IRQ_TYPE_NONE>;
		interrupt-names = "msi";
		#interrupt-cells = <1>;
		interrupt-map-mask = <0 0 0 0x7>;
		interrupt-map = <0 0 0 1 &intc 0 244 IRQ_TYPE_LEVEL_HIGH>, /* int_a */
				<0 0 0 2 &intc 0 245 IRQ_TYPE_LEVEL_HIGH>, /* int_b */
				<0 0 0 3 &intc 0 247 IRQ_TYPE_LEVEL_HIGH>, /* int_c */
				<0 0 0 4 &intc 0 248 IRQ_TYPE_LEVEL_HIGH>; /* int_d */
		clocks = <&gcc GCC_PCIE_0_CFG_AHB_CLK>,
			 <&gcc GCC_PCIE_0_MSTR_AXI_CLK>,
			 <&gcc GCC_PCIE_0_SLV_AXI_CLK>,
			 <&gcc GCC_PCIE_0_AUX_CLK>;
		clock-names = "iface", "master_bus", "slave_bus", "aux";
		resets = <&gcc GCC_PCIE_0_BCR>;
		reset-names = "core";
		power-domains = <&gcc PCIE0_GDSC>;
		vdda-supply = <&pma8084_l3>;
		phys = <&pciephy0>;
		phy-names = "pciephy";
		perst-gpio = <&tlmm 70 GPIO_ACTIVE_LOW>;
		pinctrl-0 = <&pcie0_pins_default>;
		pinctrl-names = "default";
	};

* Example for v2
	pcie0: pci@40000000 {
		compatible = "qcom,pcie-ipq4019";
		reg =  <0x40000000 0xf1d
			0x40000f20 0xa8
			0x80000 0x2000
			0x40100000 0x1000>;
		reg-names = "dbi", "elbi", "parf", "config";
		device_type = "pci";
		linux,pci-domain = <0>;
		bus-range = <0x00 0xff>;
		num-lanes = <1>;
		#address-cells = <3>;
		#size-cells = <2>;

		ranges = <0x81000000 0 0x40200000 0x40200000 0 0x00100000   /* downstream I/O */
			  0x82000000 0 0x40300000 0x40300000 0 0x00d00000>; /* non-prefetchable memory */

		interrupts = <0 142 0>;
		interrupt-names = "msi";
		#interrupt-cells = <1>;
		interrupt-map-mask = <0 0 0 0x7>;
		interrupt-map = <0 0 0 1 &intc 0 143 IRQ_TYPE_LEVEL_HIGH>, /* int_a */
				<0 0 0 2 &intc 0 144 IRQ_TYPE_LEVEL_HIGH>, /* int_b */
				<0 0 0 3 &intc 0 145 IRQ_TYPE_LEVEL_HIGH>, /* int_c */
				<0 0 0 4 &intc 0 146 IRQ_TYPE_LEVEL_HIGH>; /* int_d */
		clocks = <&gcc GCC_PCIE_AHB_CLK>,
			 <&gcc GCC_PCIE_AXI_M_CLK>,
			 <&gcc GCC_PCIE_AXI_S_CLK>;
		clock-names = "ahb",
			      "axi_m",
			      "axi_s";

		resets = <&gcc PCIE_AXI_M_ARES>,
			 <&gcc PCIE_AXI_S_ARES>,
			 <&gcc PCIE_PIPE_ARES>,
			 <&gcc PCIE_AXI_M_VMIDMT_ARES>,
			 <&gcc PCIE_AXI_S_XPU_ARES>,
			 <&gcc PCIE_PARF_XPU_ARES>,
			 <&gcc PCIE_PHY_ARES>,
			 <&gcc PCIE_AXI_M_STICKY_ARES>,
			 <&gcc PCIE_PIPE_STICKY_ARES>,
			 <&gcc PCIE_PWR_ARES>,
			 <&gcc PCIE_AHB_ARES>,
			 <&gcc PCIE_PHY_AHB_ARES>;
		reset-names = "axi_m",
			      "axi_s",
			      "pipe",
			      "axi_m_vmid",
			      "axi_s_xpu",
			      "parf",
			      "phy",
			      "axi_m_sticky",
			      "pipe_sticky",
			      "pwr",
			      "ahb",
			      "phy_ahb";

		status = "disabled";
	};

* Example for v3
	pcie0: pci@20000000 {
		compatible = "qcom,pcie-ipq807x";
		reg =  <0x20000000 0xf1d
			0x20000F20 0xa8
			0x80000 0x2000
			0x20100000 0x1000>;
		reg-names = "dbi", "elbi", "parf", "config";
		device_type = "pci";
		linux,pci-domain = <0>;
		bus-range = <0x00 0xff>;
		num-lanes = <1>;
		#address-cells = <3>;
		#size-cells = <2>;

		ranges = <0x81000000 0 0x20200000 0x20200000
			  0 0x00100000   /* downstream I/O */
			  0x82000000 0 0x20300000 0x20300000
			  0 0x00d00000>; /* non-prefetchable memory */

		interrupts = <0 52 0>;
		interrupt-names = "msi";
		#interrupt-cells = <1>;
		interrupt-map-mask = <0 0 0 0x7>;
		interrupt-map = <0 0 0 1 &intc 0 75
				 IRQ_TYPE_LEVEL_HIGH>, /* int_a */
				<0 0 0 2 &intc 0 78
				 IRQ_TYPE_LEVEL_HIGH>, /* int_b */
				<0 0 0 3 &intc 0 79
				 IRQ_TYPE_LEVEL_HIGH>, /* int_c */
				<0 0 0 4 &intc 0 83
				 IRQ_TYPE_LEVEL_HIGH>; /* int_d */
		clocks = <&gcc 0>,
			 <&gcc 0>,
			 <&gcc 0>,
			 <&gcc 0>,
			 <&gcc 0>,
			 <&gcc 0>,
			 <&gcc 0>;
		clock-names = "boot",
			      "axi_m",
			      "axi_s",
			      "ahb",
			      "aux",
			      "pipe",
			      "phy";

		resets = <&gcc GCC_PCIE0_BCR>,
			 <&gcc GCC_PCIE0_PHY_BCR>,
			 <&gcc GCC_PCIE0PHY_PHY_BCR>;
		reset-names = "pci",
			      "phy",
			      "phy1";

		perst-gpio = <&tlmm 58 1>;
		status = "ok";
		};
```

## qca/src/linux-4.4/Documentation/devicetree/bindings/phy/phy-baldur.txt
```
Qualcomm Technologies, Inc. BALDUR PHY
--------------------------------------

This file contains documentation for the USB BALDUR PHY found in Qualcomm
Technologies, Inc. IPQ40XX SoCs.

Required properties:
- compatible		: must be "qca,baldur-usb-hsphy"
- reg			: register ranges as listed in the reg-names property
- reg-names		: "phy_base"
- #phy-cells		: determine the number of cells that should be given
			  in the phandle while referencing this phy. It must
			  be zero.
- resets		: list of phandle and reset specifier pairs. There
			  should be two entries, one for the whole phy and one
			  for the port.
- reset-names           : list of reset signal names. Should be "por_rst"
			  and "srif_rst".

Optional properties:
- qca,host		: To determine host or device mode.

Example:
		usb3_hs_phy: hsphy@a6000 {
			compatible = "qca,baldur-usb-hsphy";
			reg = <0xa6000 0x40>;
			reg-names = "phy_base";
			resets = <&gcc USB3_HSPHY_POR_ARES>, <&gcc USB3_HSPHY_S_ARES>;
			reset-names = "por_rst", "srif_rst";
			qca,host = <1>;
			#phy-cells = <0>;

			status = "ok";
		};
```

## qca/src/linux-4.4/Documentation/devicetree/bindings/phy/phy-uniphy.txt
```
Qualcomm Technologies, Inc. UNIPHY
----------------------------------

This file contains documentation for the USB UNIPHY found in Qualcomm
Technologies, Inc. IPQ40XX SoCs.

Required properties:
- compatible		: must be "qca,uni-ssphy"
- reg			: register ranges as listed in the reg-names property
- reg-names		: "phy_base"
- #phy-cells		: determine the number of cells that should be given
			  in the phandle while referencing this phy. It must
			  be zero.
- resets		: list of phandle and reset specifier pairs.
- reset-names           : list of reset signal names. Should be "por_rst".

Optional properties:
- qca,host		: To determine host or device mode.

Example:
		usb3_ss_phy: ssphy@0 {
			compatible = "qca,uni-ssphy";
			reg = <0x9a000 0x800>;
			reg-names = "phy_base";
			resets = <&gcc USB3_UNIPHY_PHY_ARES>;
			reset-names = "por_rst";
			qca,host = <1>;
			#phy-cells = <0>;

			status = "ok";
		};
```

## qca/src/linux-4.4/Documentation/devicetree/bindings/phy/qca-pcie-qmp-phy.txt
```
* PCIe QMP PHY controller

PCIe PHY nodes are defined to describe on-chip PCIe Physical layer controllers.
Each PCIe PHY controller should have its own node.

- compatible:
	Usage: required
	Value type: <stringlist>
	Definition: Value should contain "qca,pcie-phy"

- reg:
	Usage: required
	Value type: <prop-encoded-array>
	Definition: Offset and length of the PCIe PHY registers

- #phy-cells:
	Usage: required
	Value type: <u32>
	Definition: Must be zero

- clocks:
	Usage: required
	Value type: <prop-encoded-array>
	Definition: A list of phandles and clock specifier pair, one
		    for each entry in clock-names property

- clock-names:
	Usage: required
	Value type: <stringlist>
	Definition: Should contain "core" for PHY core clock

- resets:
	Usage: required
	Value type: <phandle>
	Definition: List of phandle and reset specifier pairs as listed
		    in reset-names property

- reset-names:
	Usage: required
	Value type: <stringlist>
	Definition: Should contain "core" for PHY core reset


* Example

	pcie_phy0: phy@86000 {
		compatible = "qca,pcie-phy";
		reg = <0x86000 0x1000>;
		#phy-cells = <0>;
		clocks = <&gcc GCC_PCIE0_PIPE_CLK>;
		clock-names = "pipe_clk";
		resets = <&gcc GCC_PCIE0_PHY_BCR>,
			<&gcc GCC_PCIE1PHY_PHY_BCR>;
		reset-names = "phy"
				"phy_phy";
	};
```

## qca/src/linux-4.4/Documentation/devicetree/bindings/phy/qcom-ipq806x-sata-phy.txt
```
Qualcomm IPQ806x SATA PHY Controller
------------------------------------

SATA PHY nodes are defined to describe on-chip SATA Physical layer controllers.
Each SATA PHY controller should have its own node.

Required properties:
- compatible: compatible list, contains "qcom,ipq806x-sata-phy"
- reg: offset and length of the SATA PHY register set;
- #phy-cells: must be zero
- clocks: must be exactly one entry
- clock-names: must be "cfg"

Optional properties:

All of the HSIO properties below should be present for a certain
characterization requirement.
If any one of property is missed, all others are ignored and default HSIO
characterization settings will be used by the driver.
- tx_preemph_gen3: Tx driver de-emphasis value in the case where the PHY is
  running at the gen3 rate
- rx_eq: Fixed value of the RX equalizer
- mpll: mpll settings in MPLL_LOOP_CTL register
- term_off: Termination offset in TX_OVRD_DRV_HI register

Example:
	sata_phy: sata-phy@1b400000 {
		compatible = "qcom,ipq806x-sata-phy";
		reg = <0x1b400000 0x200>;

		clocks = <&gcc SATA_PHY_CFG_CLK>;
		clock-names = "cfg";

		#phy-cells = <0>;

		tx_preemph_gen3 = <0x0F>;
		rx_eq = <0x03>;
		mpll = <0x0>;
		term_off = <0x0>;
	};
```
