## qca/src/linux-4.4/Documentation/devicetree/bindings/regulator/ipq40xx-regulator.txt
```
* Qualcomm Technologies, Inc. IPQ40xx regulators

Required properties:
- compatible		: Must be "regulator-ipq40xx".
- states		: Selection of available voltages and corresponding values
- reg			: Register address for controlling LDO
- mask			: Mask value for switching voltages
Example:

	vccq_sd0: regulator@0 {
		compatible = "qcom,regulator-ipq40xx";
		regulator-name = "SD0 VccQ";
		regulator-min-microvolt = <1800000>;
		regulator-max-microvolt = <3000000>;
		states = <3000000 0x3
			1800000 0x1>;
		reg = <0x01948000 0x4>;
		mask = <0x3>;
	};
```

## qca/src/linux-4.4/Documentation/devicetree/bindings/remoteproc/q6v5-wcss-rproc.txt
```
QCA Wakeup Q6-WCSS Remoteproc Driver
=====================================

The IPQ807x family of devices uses a Q6-WCSS DSP co-processor. The Q6-WCSS
requires a firmware binary to boot. The q6-wcss remoteproc driver handles
the loading of firmware and booting of q6-wcss.

Q6v5 WCSS Device Node:
======================
A q6v5-wcss device node is used to represent the Q6-WCSS processor
instance within the SoC. It is needed as child node to SOC parent node
through which it is accessible to the IPQ807x.

Required properties:
--------------------
- compatible:		Should be one of,
				"qcom,q6v5-wcss-rproc" for IPQ807x SoCs
- reg:			Should contain the address ranges for the Q6-WCSS
			internal memory regions, QDSP6SS_PUB. The parent node
			should provide an appropriate range property for
			properly translating these into bus addresses.
- firmware:		Name of firmware file to be used for loading and
			booting the q6-wcss remote processor.
- interrupt-extended	Used to tell the incoming interrupts through SMP2P
- interrupt-names	Names of incoming interrupts
- qcom,smem-states	Output from APPS to Q6 processor
- qcom,smem-state-names Names of the output values from APPS to Q6 processor
- qca,emulation		States that this driver is used on emulation platform
- qca,auto-restart      states that q6 is restarted after receiving error fatal
			from q6
- qca,extended-intc	notifies that virtual interrupt controller is used
			instead of virtual GPIOs
- qca,secure		notifies that TZ is used for bringing q6 out of reset

Example:
--------
/* IPQ807x */
soc {
	q6v5_wcss@0x0AD00000 {
		compatible = "qcom,rproc-q6v5-wcss";
		firmware = "q6-wcss-boot";
		reg = <0xC900000 0x4040>;
		interrupts-extended = <&intc 0 325 1>,
					<&wcss_smp2p_in 0 0>,
					<&wcss_smp2p_in 1 0>,
					<&wcss_smp2p_in 3 0>;
		interrupt-names = "wdog",
				  "fatal",
				  "handover",
				  "stop-ack";
		qcom,smem-states = <&wcss_smp2p_out 0>,
				   <&wcss_smp2p_out 1>;
		qcom,smem-state-names = "shutdown",
					"stop";

		qca,emulation = <1>;
	};
	...
};
```

## qca/src/linux-4.4/Documentation/devicetree/bindings/soc/qcom/ipq,tcsr.txt
```
Qualcomm Technologies Inc TCSR (Top Control and Status Register) Driver

The TCSR provides miscellaneous control functions and status registers for
Qualcomm Technologies Inc processors.

Required properties:
- compatible: must contain "ipq,tcsr" for IPQ806x
- reg: Address range for TCSR registers

Optional properties:
- ipq,usb-ctrl-select : indicates USB port type selection.  Please reference
  dt-bindings/soc/ipq,tcsr.h for valid USB port selection values.

Example for IPQ8064:

#include <dt-bindings/soc/ipq,tcsr.h>

		tcsr: tcsr@1a400000 {
			compatible = "ipq,tcsr";
			reg = <0x1a400000 0x100>;

			ipq,usb-ctrl-select = <TCSR_USB_SELECT_USB3_DUAL>;
		};
```

## qca/src/linux-4.4/Documentation/devicetree/bindings/soc/qcom/qca,scm_restart_reason.txt
```
QCA SCM_RESTART_REASON

scm restart reason driver controls the collection of crashdump.
During panic/assert the notifiers registered in this driver will be kicked in
and the magic cookie is set, the crashdumps are collected in apps bootloader.

Required properties:
 - compatible: must contain "qca,scm_restart_reason" for IPQ40xx


Example for ipq40xx:

	qca,scm_restart_reason {
		compatible = "qca,scm_restart_reason";
	};
```

## qca/src/linux-4.4/Documentation/devicetree/bindings/soc/qcom/qca,tzlog.txt
```
QCA TZLOG

This binding describes tzlog used to inspect log created by TZ. This driver
also provides capability to capture SMMU and XPU faults found by TZ.

Required properties:
 - compatible: must contain one of "qca,tzlog"
				   "qca,tz64-hv-log"
				   "qca,tz64log"
 - interrupts: must contain interrupt used by TZ when XPU or SMMU faults are
		found

Example:

	qca,tzlog {
		compatible = "qca,tz64log";
		interrupts = <0 244 0>;
	};

	qca,tzlog {
		compatible = "qca,tz64-hv-log";
		interrupts = <0 244 0>;
	};

	qca,tzlog {
		compatible = "qca,tzlog";
	};
```

## qca/src/linux-4.4/Documentation/devicetree/bindings/soc/qcom/qca,tzlog_ipq806x.txt
```
QCA TZLOG_IPQ806X

The tz_log driver is used to provide tz diagnostic information to the user space.
It also provides capability to capture SMMU and XPU faults found by TZ.
This binding is specifically used to make the driver compatible for ipq806x.

Required properties:
- compatible: must contain "qca,tzlog_ipq806x" for IPQ806x

Example for ipq806x:

	qca,tzlog {
		compatible = "qca,tzlog_ipq806x";
	};
```

## qca/src/linux-4.4/Documentation/devicetree/bindings/soc/qcom/qcom,gobi-9x35.txt
```
QCA GOBI-9X35

GobiNet driver is used to communicate with Gobi modems
using QMI protocol over usb interface

Example for ipq40xx:
			qcom,Gobi {
				compatible = "qcom,gobi-9x35";
				status = "ok"
				};
```

## qca/src/linux-4.4/Documentation/devicetree/bindings/sound/qca,ipq4019-audio-adss.txt
```
* Qualcomm Technologies IPQ4019 ASoC audio subsystem driver

This node models the Qualcomm Technologies IPQ4019 ASoC audio subsystem driver

Required properties:

- compatible	: "qca,ipq4019-audio-adss"
- reg		: should have the stereo register address, length
- resets	: references to the reset controllers
- reset-names	: should be "blk_rst"


Example:
audio: audio@7700000 {
	compatible = "qca,ipq4019-audio-adss";
	reg = <0x7700000 0x34>;
	resets = <&gcc AUDIO_BLK_ARES>;
	reset-names = "blk_rst";
	status = "disabled";
};
```

## qca/src/linux-4.4/Documentation/devicetree/bindings/sound/qca,ipq4019-audio.txt
```
* Qualcomm Technologies IPQ4019 ASoC machine driver

This node models the Qualcomm Technologies IPQ4019 ASoC machine driver

Required properties:

- compatible		: "qca,ipq4019-audio"

Example:

sound: sound {
	compatible = "qca,ipq4019-audio";
};
```

## qca/src/linux-4.4/Documentation/devicetree/bindings/sound/qca,ipq4019-codec.txt
```
* Qualcomm Technologies IPQ4019 ASoC Codec driver

This node models the Qualcomm Technologies IPQ4019 ASoC Codec driver

Required properties:

- compatible	: "qca,ipq4019-codec"
- reg		: should have the stereo i2c register address

Example:
qca_codec: qca_codec@12 {
	compatible = "qca,ipq4019-codec";
	reg = <0x12>;
	status = "disabled";
};
```

## qca/src/linux-4.4/Documentation/devicetree/bindings/sound/qca,ipq4019-i2s.txt
```
* Qualcomm Technologies IPQ4019 ASoC PCM driver

This node models the Qualcomm Technologies IPQ4019 ASoC I2S PCM driver

Required properties:

- compatible	 : "qca,ipq4019-i2s"
- dma-tx-channel : should have the mbox tx channel id
- dma-rx-channel : should have the mbox rx channel id
- stereo-tx-port : should have the stereo tx id
- stereo-rx-port : should have the stereo rx id
- clocks	 : should have the audio tx bit clock, tx master clock,
		   rx bit clock, rx master clock id
- clock-names	 : should be "audio_tx_bclk", "audio_tx_mclk", "audio_rx_bclk",
		   "audio_rx_mclk"

Example:
i2s: ipq4019-pcm-i2s@0 {
	compatible = "qca,ipq4019-i2s";
	dma-tx-channel = <MBOX0_TX_ID>;
	dma-rx-channel = <MBOX3_RX_ID>;
	stereo-tx-port = <STEREO0_ID>;
	stereo-rx-port = <STEREO3_ID>;
	clocks = <&adcc ADCC_TXB_CLK_SRC>,
		<&adcc ADCC_TXM_CLK_SRC>,
		<&adcc ADCC_RXB_CLK_SRC>,
		<&adcc ADCC_RXM_CLK_SRC>;
	clock-names = "audio_tx_bclk",
		"audio_tx_mclk",
		"audio_rx_bclk",
		"audio_rx_mclk";
	status = "disabled";
};
```

## qca/src/linux-4.4/Documentation/devicetree/bindings/sound/qca,ipq4019-i2s1.txt
```
* Qualcomm Technologies IPQ4019 ASoC I2S PCM driver

This node models the Qualcomm Technologies IPQ4019 ASoC I2S PCM driver

Required properties:

- compatible	 : "qca,ipq4019-i2s1"
- dma-tx-channel : should have the mbox tx channel id
- stereo-tx-port : should have the stereo tx id
- clocks	 : should have the audio tx bit clock, tx master clock,
		   rx bit clock, rx master clock id
- clock-names	 : should be "audio_tx_bclk", "audio_tx_mclk", "audio_rx_bclk",
		   "audio_rx_mclk"

Example:
i2s1: ipq4019-pcm-i2s1@0 {
	compatible = "qca,ipq4019-i2s1";
	dma-tx-channel = <MBOX1_TX_ID>;
	stereo-tx-port = <STEREO1_ID>;
	clocks = <&adcc ADCC_TXB_CLK_SRC>,
		<&adcc ADCC_TXM_CLK_SRC>,
		<&adcc ADCC_RXB_CLK_SRC>,
		<&adcc ADCC_RXM_CLK_SRC>;
	clock-names = "audio_tx_bclk",
		"audio_tx_mclk",
		"audio_rx_bclk",
		"audio_rx_mclk";
	status = "disabled";
};
```

## qca/src/linux-4.4/Documentation/devicetree/bindings/sound/qca,ipq4019-mbox.txt
```
* Qualcomm Technologies IPQ4019 ASoC MBOX driver

This node models the Qualcomm Technologies IPQ4019 ASoC mbox driver

Required properties:

- compatible	 : "qca,ipq4019-mbox"
- dma-index	 : should have the mbox dma index
- reg		 : should have the stereo register address, length
- interrupts	 : should have the mbox interrupt no
- tx-channel	 : should have the mbox tx id
- rx-channel	 : should have the mbox rx id

Example:
mbox0: mbox@7708000 {
	compatible = "qca,ipq4019-mbox";
	dma-index = <0>;
	reg = <0x7708000 0x1000>;
	interrupts = <0 156 0>;
	tx-channel = <MBOX0_TX_ID>;
	rx-channel = <MBOX0_RX_ID>;
	status = "disabled";
};
```

## qca/src/linux-4.4/Documentation/devicetree/bindings/sound/qca,ipq4019-pcm-i2s.txt
```
* Qualcomm Technologies IPQ4019 ASoC platform driver

This node models the Qualcomm Technologies IPQ4019 ASoC platform driver

Required properties:

- compatible	 : "qca,ipq4019-pcm-i2s"
- reg		 : should have the stereo register address, length

Example:
i2splatform: qca-pcm-i2s@7709000 {
	compatible = "qca,ipq4019-pcm-i2s";
	reg = <0x7709000 0x1000>;
	status = "disabled";
};
```

## qca/src/linux-4.4/Documentation/devicetree/bindings/sound/qca,ipq4019-pcm-i2s1.txt
```
* Qualcomm Technologies IPQ4019 ASoC platform driver

This node models the Qualcomm Technologies IPQ4019 ASoC platform driver

Required properties:

- compatible	 : "qca,ipq4019-pcm-i2s1"
- reg		 : should have the stereo register address, length

Example:
i2s1platform: qca-pcm-i2s1@770b000 {
	compatible = "qca,ipq4019-pcm-i2s1";
	reg = <0x770b000 0x1000>;
	status = "disabled";
};
```

## qca/src/linux-4.4/Documentation/devicetree/bindings/sound/qca,ipq4019-pcm-i2s2.txt
```
* Qualcomm Technologies IPQ4019 ASoC platform driver

This node models the Qualcomm Technologies IPQ4019 ASoC platform driver

Required properties:

- compatible	 : "qca,ipq4019-pcm-i2s2"
- reg		 : should have the stereo register address, length

Example:
i2s2platform: qca-pcm-i2s1@770d000 {
	compatible = "qca,ipq4019-pcm-i2s2";
	reg = <0x770d000 0x1000>;
	status = "disabled";
};
```

## qca/src/linux-4.4/Documentation/devicetree/bindings/sound/qca,ipq4019-pcm-lb.txt
```
qca,ipq4019-pcm-lb

VOIP PCM driver loopback test module for IPQ4019

Required properties:

  - compatible : "qca,ipq4019-pcm-lb"

Example:

pcm_lb: pcm_lb@0 {
        compatible = "qca,ipq4019-pcm-lb";
};
```

## qca/src/linux-4.4/Documentation/devicetree/bindings/sound/qca,ipq4019-pcm-spdif.txt
```
* Qualcomm Technologies IPQ4019 ASoC SPDIF platform driver

This node models the Qualcomm Technologies IPQ4019 ASoC SPDIF platform driver

Required properties:

- compatible	 : "qca,ipq4019-pcm-spdif"
- reg		 : should have the stereo register address, length

Example:
tdmplatform: qca-pcm-spdif@7707000 {
	compatible = "qca,ipq4019-pcm-spdif";
	reg = <0x7709000 0x1000>;
	status = "disabled";
};
```

## qca/src/linux-4.4/Documentation/devicetree/bindings/sound/qca,ipq4019-pcm-tdm.txt
```
* Qualcomm Technologies IPQ4019 ASoC TDM platform driver

This node models the Qualcomm Technologies IPQ4019 ASoC TDM platform driver

Required properties:

- compatible	 : "qca,ipq4019-pcm-tdm"
- reg		 : should have the stereo register address, length

Example:
tdmplatform: qca-pcm-tdm@7709000 {
	compatible = "qca,ipq4019-pcm-tdm";
	reg = <0x7709000 0x1000>;
	status = "disabled";
};
```

## qca/src/linux-4.4/Documentation/devicetree/bindings/sound/qca,ipq4019-spdif.txt
```
* Qualcomm Technologies IPQ4019 ASoC SPDIF driver

This node models the Qualcomm Technologies IPQ4019 ASoC SPDIF driver

Required properties:

- compatible	 : "qca,ipq4019-spdif"
- dma-tx-channel : should have the mbox tx channel id
- dma-rx-channel : should have the mbox rx channel id
- stereo-tx-port : should have the stereo tx id
- stereo-rx-port : should have the stereo tx id
- clocks	 : should have the audio tx bit clock, tx master clock,
		   spdif clock, spdif divider clock, spdif in fast clock
- clock-names	 : should be "audio_tx_bclk", "audio_tx_mclk", "audio_spdif_src",
		   "audio_spdif_div2", "audio_spdifinfast_src"

Example:
spdif: spdif@0 {
	compatible = "qca,ipq4019-spdif";
	dma-tx-channel = <MBOX0_TX_ID>;
	dma-rx-channel = <MBOX3_RX_ID>;
	stereo-tx-port = <STEREO0_ID>;
	stereo-rx-port = <STEREO3_ID>;
	clocks = <&adcc ADCC_TXB_CLK_SRC>,
		<&adcc ADCC_TXM_CLK_SRC>,
		<&adcc ADCC_SPDIF_SRC>,
		<&adcc ADCC_SPDIFDIV2_SRC>,
		<&adcc ADCC_AUDIO_SPDIFINFAST_SRC>;
	clock-names = "audio_tx_bclk",
		"audio_tx_mclk",
		"audio_spdif_src",
		"audio_spdif_div2",
		"audio_spdifinfast_src";
	status = "disabled";
};
```

## qca/src/linux-4.4/Documentation/devicetree/bindings/sound/qca,ipq4019-stereo.txt
```
* Qualcomm Technologies IPQ4019 ASoC stereo driver

This node models the Qualcomm Technologies IPQ4019 ASoC stereo driver

Required properties:

- compatible	 : "qca,ipq4019-stereo"
- reg		 : should have the stereo register address, length
- stereo-index	 : should have the stereo port index

Example:
stereo0: stereo@7709000 {
	compatible = "qca,ipq4019-stereo";
	reg = <0x7709000 0x1000>;
	stereo-index = <STEREO0_ID>;
	status = "disabled";
};
```

## qca/src/linux-4.4/Documentation/devicetree/bindings/sound/qca,ipq4019-tdm.txt
```
* Qualcomm Technologies IPQ4019 ASoC TDM driver

This node models the Qualcomm Technologies IPQ4019 ASoC TDM driver

Required properties:

- compatible	 : "qca,ipq4019-tdm"
- dma-tx-channel : should have the mbox tx channel id
- dma-rx-channel : should have the mbox rx channel id
- stereo-tx-port : should have the stereo tx id
- stereo-rx-port : should have the stereo tx id
- clocks	 : should have the audio tx bit clock, tx master clock,
		   rx bit clock, rx master clock id
- clock-names	 : should be "audio_tx_bclk", "audio_tx_mclk", "audio_rx_bclk",
		   "audio_rx_mclk"

Example:
tdm: tdm@0 {
	compatible = "qca,ipq4019-tdm";
	dma-tx-channel = <MBOX0_TX_ID>;
	dma-rx-channel = <MBOX3_RX_ID>;
	stereo-tx-port = <STEREO0_ID>;
	stereo-rx-port = <STEREO3_ID>;
	clocks = <&adcc ADCC_TXB_CLK_SRC>,
		<&adcc ADCC_TXM_CLK_SRC>,
		<&adcc ADCC_RXB_CLK_SRC>,
		<&adcc ADCC_RXM_CLK_SRC>;
	clock-names = "audio_tx_bclk",
		"audio_tx_mclk",
		"audio_rx_bclk",
		"audio_rx_mclk";
	status = "disabled";
};
```

## qca/src/linux-4.4/Documentation/devicetree/bindings/sound/qca,ipq806x-lpaif.txt
```
qca,ipq806x-lpaif

LPA_IF driver for IPQ806x

Required properties:

  - compatible     : "qca,ipq806x-lpaif"
  - reg		   : should have the pcm register address, length
  - interrupts	   : should have the LPA_IF interrupt number
  - clocks	   : should have the pcm bit clock
  - clock-names    : should be "pcm_bit_clk"
  - resets	   : references to the reset controllers
  - reset-names	   : should be "lcc_pcm_reset"

Example:

lpaif: lpaif@28100000 {
	compatible = "qca,ipq806x-lpaif";
	reg = <0x28100000 0xFFFF>;
	interrupts = <0 85 0>;
	clocks = <&lcc PCM_CLK>;
	clock-names = "pcm_bit_clk";
	resets = <&lcc LCC_PCM_RESET>;
	reset-names = "lcc_pcm_reset";
};
```
