## qca/src/linux-4.4/Documentation/devicetree/bindings/sound/qca,ipq806x-pcm.txt
```
qca,ipq806x-pcm

VOIP PCM driver for IPQ806X

Required properties:

  - compatible		: "qca,ipq806x-pcm"
  - pinctrl-N		: One property must exist for each entry in
			  pinctrl-names.  See ../pinctrl/pinctrl-bindings.txt
			  for details of the property values.
  - pinctrl-names	: Must contain a "default" entry.


Example:
pcm: pcm@28100000 {
	compatible = "qca,ipq806x-pcm";
	pinctrl-0 = <&voip_pins>;
	pinctrl-names = "default";
};
```

## qca/src/linux-4.4/Documentation/devicetree/bindings/sound/qca,ipq8074-audio.txt
```
* Qualcomm Technologies, Inc IPQ8074 ASoC machine driver

This node models the Qualcomm Technologies, Inc IPQ8074 ASoC machine driver

Required properties:

- compatible		: "qca,ipq8074-audio"

Example:

sound: sound {
	compatible = "qca,ipq8074-audio";
};
```
