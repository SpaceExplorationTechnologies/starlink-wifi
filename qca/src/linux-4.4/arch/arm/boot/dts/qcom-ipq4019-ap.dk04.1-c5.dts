/* Copyright (c) 2016, The Linux Foundation. All rights reserved.
 *
 * Permission to use, copy, modify, and/or distribute this software for any
 * purpose with or without fee is hereby granted, provided that the above
 * copyright notice and this permission notice appear in all copies.
 *
 * THE SOFTWARE IS PROVIDED "AS IS" AND THE AUTHOR DISCLAIMS ALL WARRANTIES
 * WITH REGARD TO THIS SOFTWARE INCLUDING ALL IMPLIED WARRANTIES OF
 * MERCHANTABILITY AND FITNESS. IN NO EVENT SHALL THE AUTHOR BE LIABLE FOR
 * ANY SPECIAL, DIRECT, INDIRECT, OR CONSEQUENTIAL DAMAGES OR ANY DAMAGES
 * WHATSOEVER RESULTING FROM LOSS OF USE, DATA OR PROFITS, WHETHER IN AN
 * ACTION OF CONTRACT, NEGLIGENCE OR OTHER TORTIOUS ACTION, ARISING OUT OF
 * OR IN CONNECTION WITH THE USE OR PERFORMANCE OF THIS SOFTWARE.
 *
 */

#include "qcom-ipq4019-ap.dk04.1.dtsi"
/ {
	model = "Qualcomm Technologies, Inc. IPQ4019/AP-DK04.1-C5";

	soc {
		spi_0: spi@78b5000 { /* BLSP1 QUP1 */
			status = "ok";
			cs-gpios = <&tlmm 12 0>, <&tlmm 45 0>;
			num-cs = <2>;

			mt29f@1 {
				#address-cells = <1>;
				#size-cells = <1>;
				compatible = "spinand,mt29f";
				reg = <1>;
				spi-max-frequency = <24000000>;
			};

		};
	};
};
