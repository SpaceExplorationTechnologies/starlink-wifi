/*
 * Copyright (c) 2016 - 2017, The Linux Foundation. All rights reserved.
 *
 * This program is free software; you can redistribute it and/or modify
 * it under the terms of the GNU General Public License version 2 and
 * only version 2 as published by the Free Software Foundation.
 *
 * This program is distributed in the hope that it will be useful,
 * but WITHOUT ANY WARRANTY; without even the implied warranty of
 * MERCHANTABILITY or FITNESS FOR A PARTICULAR PURPOSE.  See the
 * GNU General Public License for more details.
 */

/dts-v1/;
#include "ipq807x-soc.dtsi"
#include <dt-bindings/qcom/gpio-ipq807x.h>
/ {
	model ="QCA, IPQ807x-HK05";
	compatible = "qca,ipq807x", "qca,ipq807x-hk05";
	machid = <0x080100002>;
	config_name = "config@hk05";

	aliases {
		console = "/serial@78B3000";
		i2c0 = "/i2c@78b6000";
		pci0 = "/pci@20000000";
		pci1 = "/pci@10000000";
	};
};

